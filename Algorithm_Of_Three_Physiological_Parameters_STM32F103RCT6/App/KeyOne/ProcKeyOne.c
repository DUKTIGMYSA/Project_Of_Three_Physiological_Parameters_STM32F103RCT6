/*********************************************************************************************************
* 模块名称：ProcKeyOne.c
* 摘    要：ProcKeyOne模块，进行独立按键处理模块初始化，以及独立按键处理函数实现
* 当前版本：1.0.0
* 作    者：SZLY(COPYRIGHT 2018 - 2020 SZLY. All rights reserved.)
* 完成日期：2020年01月01日   
* 内    容：
* 注    意：                                                                  
**********************************************************************************************************
* 取代版本：
* 作    者：
* 完成日期：
* 修改内容：
* 修改文件：
*********************************************************************************************************/

/*********************************************************************************************************
*                                              包含头文件
*********************************************************************************************************/
#include "ProcKeyOne.h"
#include "Temp.h"
#include "LED.h"
#include "ADC.h"
#include "main.h"
#include "SendDataToHost.h"
/*********************************************************************************************************
*                                              宏定义
*********************************************************************************************************/

/*********************************************************************************************************
*                                              枚举结构体定义
*********************************************************************************************************/

/*********************************************************************************************************
*                                              内部变量
*********************************************************************************************************/
 static u8 stateNum;    // 三参状态
 static u8 KeyNum;      // 当值为1时表示的是检测通道S1，值为2时表示的是检测通道S2
 static u8 KeyRenew;    // 判断通道是否被切换成检验通道（PA或PB通道）
 
 static i8 KeyModel;    // 判断是位于哪个通道
 // KeyModel要转换为两个位数的二进制数据并与LED1与LED2一一对应，LED1对应最左边位数的二进制，LED2对应最右边位数的二进制
 // 例如：当KeyModel = 0时即KeyModel = 0b00，意为LED1与LED2都熄灭，此时通道为PB通道
 // 当KeyModel = 1时即KeyModel = 0b01，意为LED1灭，LED2亮，此时通道为S2通道
 // 当KeyModel = 2时即KeyModel = 0b10，意为LED1亮，LED2灭，此时通道为S1通道
 // 当KeyModel = 3时即KeyModel = 0b11，意为LED1与LED2都点亮，此时通道为PA通道
 
 /*********************************************************************************************************
*                                              外部变量
*********************************************************************************************************/
 extern u8 keyNumber;   // 表示的是通道自动切换的顺序（PA->PB->S1/S2通道->PA，当值为0时停止切换通道）
 extern u8 keyChange;   // 表示的是是否通过按下按钮选择通道
 extern u8 s_arrTempData[6];
/*********************************************************************************************************
*                                              内部函数声明
*********************************************************************************************************/

/*********************************************************************************************************
*                                              内部函数实现
*********************************************************************************************************/
/*********************************************************************************************************
* 函数名称：
* 函数功能：
* 输入参数：
* 输出参数：
* 返 回 值：
* 创建日期：2018年01月01日
* 注    意：
*********************************************************************************************************/

/*********************************************************************************************************
*                                              API函数实现
*********************************************************************************************************/
/*********************************************************************************************************
* 函数名称：InitProcKeyOne
* 函数功能：初始化ProcKeyOne模块
* 输入参数：void
* 输出参数：void
* 返 回 值：void
* 创建日期：2018年01月01日
* 注    意：
*********************************************************************************************************/
void InitProcKeyOne(void)
{
  stateNum = 0;
  
  // 下列变量设定都是未选择通道进行设置
  KeyNum = 0;        
  KeyRenew = FALSE;    
  KeyModel = -1;
}

/*********************************************************************************************************
* 函数名称：ProcKeyDownKey1
* 函数功能：处理按键按下的事件，即按键按下的响应函数 
* 输入参数：void
* 输出参数：void
* 返 回 值：void
* 创建日期：2018年01月01日
* 注    意：
*********************************************************************************************************/
void  ProcKeyDownKey1(void)
{  
  stateNum = stateNum % 3 + 1;  
  
  if(stateNum == 1)  // 当参数模块为体温模块时
  {
    ADC_RegularChannelConfig(ADC1, ADC_Channel_6, 1, ADC_SampleTime_239Cycles5); //设置采样时间为239.5个周期
//    ConfigTimer3(799, 719);   //100KHz，计数到800为8ms
  }
  else if(stateNum == 2) // 当参数模块为心电模块时
  {
    ADC_RegularChannelConfig(ADC1, ADC_Channel_14, 1, ADC_SampleTime_239Cycles5); //设置采样时间为239.5个周期
  }
  else if(stateNum == 3)  // 当参数模块为血氧模块时
  {
    ADC_RegularChannelConfig(ADC1, ADC_Channel_5, 1, ADC_SampleTime_239Cycles5); //设置采样时间为239.5个周期
    ConfigSPO2LEDGPIO();
//    ConfigTimer3(1, 719);   //100KHz，计数到800为8ms
    
  }
}

/*********************************************************************************************************
* 函数名称：ProcKeyUpKey1
* 函数功能：处理按键弹起的事件，即按键弹起的响应函数 
* 输入参数：void
* 输出参数：void
* 返 回 值：void
* 创建日期：2018年01月01日
* 注    意：
*********************************************************************************************************/
void  ProcKeyUpKey1(void)
{
//  printf("KEY1 RELEASE\r\n");   //打印按键状态
}

/*********************************************************************************************************
* 函数名称：ProcKeyDownKey2
* 函数功能：处理按键按下的事件，即按键按下的响应函数 
* 输入参数：void
* 输出参数：void
* 返 回 值：void
* 创建日期：2018年01月01日
* 注    意： 
*********************************************************************************************************/
void  ProcKeyDownKey2(void)
{
  if(stateNum == 1)              // 当参数模块为体温模块时
  {
    keyChange = TRUE;            // 此刻已按下按钮选择通道
    keyNumber = 1;               // 通道将从PA通道开始切换
    KeyNum = (KeyNum + 1) % 2;   // 此刻选择的通道为S1检测通道
    if((KeyNum == 1)||(KeyRenew == TRUE))  // 当通道选择为S1检测通道或前面通道切换为检验通道（PA或PB通道）
    {
      if(KeyRenew == TRUE)                 // 当前面通道切换为检验通道（PA或PB通道）
      {
        KeyRenew = FALSE;                  // 判断通道切换变量状态更新
        KeyNum = 1;                        // 将之前的检测通道刷新为S1检测通道
      }
      KeyModel = 2;                        // KeyModel = 0b10，意为LED1亮，LED2灭，此时通道为S1通道
      LEDFlicker(T_SENS1);                 // LED1亮，LED2灭
      TempWriteBit(T_SENS1);               // 通道切换为S1检测通道
    }
    else                                   // 当通道选择为检测通道S2
    {
      KeyModel = 1;                        // KeyModel = 0b01，意为LED1灭，LED2亮，此时通道为S2通道
      LEDFlicker(T_SENS2);                 // LED1灭，LED2亮
      TempWriteBit(T_SENS2);               // 通道切换为S2检测通道
    }
  }
//  KeyRenew = TRUE;                  // 此刻通道切换为PA检验通道
//  KeyModel = 3;                     // KeyModel = 0b11，意为LED1与LED2都点亮，此时通道为PA通道
//  keyChange = TRUE;                 // 已按下按钮选择PA通道
//  keyNumber = 1;                    // 通道将从PA通道开始切换
//  LEDFlicker(T_PA);                 // LED1与LED2都点亮
//  TempWriteBit(T_PA);               // 通道切换为PA检验通道
  
////  printf("KEY2 PUSH DOWN\r\n");   // 打印按键状态
}

/*********************************************************************************************************
* 函数名称：ProcKeyUpKey2
* 函数功能：处理按键弹起的事件，即按键弹起的响应函数 
* 输入参数：void
* 输出参数：void
* 返 回 值：void
* 创建日期：2018年01月01日
* 注    意：
*********************************************************************************************************/
void  ProcKeyUpKey2(void)
{
//  printf("KEY2 RELEASE\r\n");     //打印按键状态
}

/*********************************************************************************************************
* 函数名称：ProcKeyDownKey3
* 函数功能：处理按键按下的事件，即按键按下的响应函数 
* 输入参数：void
* 输出参数：void
* 返 回 值：void
* 创建日期：2018年01月01日
* 注    意：
*********************************************************************************************************/
void  ProcKeyDownKey3(void)
{
//  KeyRenew = TRUE;             // 此刻通道切换为PB检验通道
//  KeyModel = 0;                // KeyModel = 0b00，意为LED1与LED2都熄灭，此时通道为PB检验通道
//  keyChange = TRUE;            // 已按下按钮选择PB通道
//  keyNumber = 1;               // 通道将从PA通道开始切换
//  LEDFlicker(T_PB);            // LED1与LED2都熄灭
//  TempWriteBit(T_PB);          // 通道切换为PB检验通道
  
////  printf("KEY3 PUSH DOWN\r\n");   //打印按键状态
}

/*********************************************************************************************************
* 函数名称：ProcKeyUpKey3
* 函数功能：处理按键弹起的事件，即按键弹起的响应函数 
* 输入参数：void
* 输出参数：void
* 返 回 值：void
* 创建日期：2018年01月01日
* 注    意：
*********************************************************************************************************/
void  ProcKeyUpKey3(void)
{  
//  printf("KEY3 RELEASE\r\n");     //打印按键状态
}

/*********************************************************************************************************
* 函数名称：BoolKeyRenew
* 函数功能：判断检测通道是否被切换成检验通道 
* 输入参数：void
* 输出参数：void
* 返 回 值：void
* 创建日期：2018年01月01日
* 注    意：
*********************************************************************************************************/
u8 BoolKeyRenew(void)
{
  return KeyRenew;
}

/*********************************************************************************************************
* 函数名称：BoolKeyNum
* 函数功能：判断检测通道是1还是2 
* 输入参数：void
* 输出参数：void
* 返 回 值：void
* 创建日期：2018年01月01日
* 注    意：
*********************************************************************************************************/
u8 BoolKeyNum(void)
{
  return KeyNum;
}

/*********************************************************************************************************
* 函数名称：BoolKeyNum
* 函数功能：判断是位于哪个通道 
* 输入参数：void
* 输出参数：void
* 返 回 值：void
* 创建日期：2018年01月01日
* 注    意：
*********************************************************************************************************/
i8 BoolKeyModel(void)
{
  return KeyModel;
}

/*********************************************************************************************************
* 函数名称：GetStateNum
* 函数功能：获取三参状态 
* 输入参数：void
* 输出参数：void
* 返 回 值：void
* 创建日期：2018年01月01日
* 注    意：
*********************************************************************************************************/
u8 GetStateNum(void)
{
  return stateNum;
}
