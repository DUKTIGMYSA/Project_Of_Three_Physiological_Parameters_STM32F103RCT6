/*********************************************************************************************************
* 模块名称：Fliter.c
* 摘    要：滤波模块，滤除工频干扰和基线漂移
* 当前版本：1.0.0
* 作    者：SZLY(COPYRIGHT 2018 - 2020 SZLY. All rights reserved.)
* 完成日期：2020年01月01日 
* 内    容：
* 注    意：                                                                  
**********************************************************************************************************
* 取代版本：
* 作    者：
* 完成日期：
* 修改内容：
* 修改文件：
*********************************************************************************************************/

/*********************************************************************************************************
*                                              包含头文件
*********************************************************************************************************/
#include "Filter.h"
//#include "stm32f10x_conf.h"

/*********************************************************************************************************
*                                              宏定义
*********************************************************************************************************/
// 定义FIR滤波器的长度
#define FILTER_LENGTH 65
/*********************************************************************************************************
*                                              枚举结构体定义
*********************************************************************************************************/

/*********************************************************************************************************
*                                              内部变量
*********************************************************************************************************/


//低通滤波器，滤掉工频干扰，Fs=500Hz,Fc=35Hz，Hann窗，64阶，65个系数
static double s_arrLowpassHann64N[] = {
 0,                                       
 0.000021657184536017600238024319314611432,
 0.000059898797863103372994889039837573819,
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 0.000021657184536017600238024319314611432,
 0  
};




// IIR高通滤波器截止频率 0.60HZ
// fs=500Hz
static const float b[ORDER + 1] = {	
	0.9946827,
	-1.9893654,
 	0.9946827};
static const float a[ORDER + 1] = {
 	1,                                        
	-1.9893371,
	 0.9893937  };


/*********************************************************************************************************
*                                              内部函数声明
*********************************************************************************************************/


/*********************************************************************************************************
*                                              内部函数实现
*********************************************************************************************************/
/*********************************************************************************************************
 * 函数名称：Butterworth_2N
 * 函数功能：二阶高通Butterworth，滤除基线漂移
 * 输入参数：
 * 输出参数：void
 * 返 回 值：
 * 创建日期：2024年7月19日
 * 修改日期：
 * 注    意：
 *********************************************************************************************************/
static void Butterworth_2N(float *b, float *a,          // 滤波器系数
                            int m, int n,                // m 为 b 系数长度减一，n 为 a 系数长度减一
                            float *x, int len,           // x 为输入信号数组，len 为数组长度
                            float *px, float *py, int k) // px 为过去输入信号数组，py 为过去输出信号数组，k 为当前处理的信号位置
{
  int i;
  // 将当前输入信号存储到 px[0]
  px[0] = x[k];
  // 初始化 x[k] 为 0.0，用于计算滤波后的信号
  x[k] = 0.0;

  // 使用分子系数 b 和过去的输入信号 px 计算当前的滤波信号部分
  for (i = 0; i <= m; i++)
  {
    x[k] = x[k] + b[i] * px[i];
  }

  // 使用分母系数 a 和过去的输出信号 py 调整当前的滤波信号部分
  for (i = 1; i <= n; i++)
  {
    x[k] = x[k] - a[i] * py[i];
  }

  // 检查计算后的 x[k] 是否超出设定范围（这里为 ±10^10），如果超出，表明计算出现错误
  if (x[k] > 100000000 || x[k] < -100000000)
  {
    // 错误处理
  }

  // 将 px 数组的元素向后移动一个位置，以存储新的输入信号
  for (i = m; i >= 1; i--)
  {
    px[i] = px[i - 1];
  }

  // 将 py 数组的元素向后移动一个位置，以存储新的输出信号
  for (i = n; i >= 1; i--)
  {
    py[i] = py[i - 1];
  }

  // 将计算出的 x[k] 存储到 py[1]，以用于下一次的滤波计算
  py[1] = x[k];
  
}

/*********************************************************************************************************
*                                              API函数实现
*********************************************************************************************************/
/*********************************************************************************************************
* 函数名称：InitFilter
* 函数功能：初始化Wave模块 
* 输入参数：void
* 输出参数：void
* 返 回 值：void
* 创建日期：2018年01月01日
* 注    意：
*********************************************************************************************************/
void  InitFilter(void)
{
  
}

/*********************************************************************************************************
* 函数名称：LowpassFilter_FIR
* 函数功能：低通FIR，64阶Hann，滤除工频干扰和高频噪声
* 输入参数：u16 adcdata
* 输出参数：void
* 返 回 值：output
* 创建日期：2018年01月01日
* 注    意：
*********************************************************************************************************/
double LowpassFilter_FIR(u16 data) 
{
    double output = 0.0;
    static double arrLastInput[FILTER_LENGTH] = {0}; // 静态数组用于存储先前的输入
    int i;
    int j;
    for (i = FILTER_LENGTH - 1; i >= 0; --i) 
    {
       arrLastInput[i] = arrLastInput[i-1]; //将数组整体右移一位，并填入新采集的data到数组首位
    }
    arrLastInput[0] = data;

    for (j = 0; j < FILTER_LENGTH; ++j) 
    {     
      output += s_arrLowpassHann64N[j] * arrLastInput[j];
    }
    
    return output;
}

/*********************************************************************************************************
 * 函数名称：highpassFilter_IIR
 * 函数功能：IIR滤波器API
 * 输入参数：void
 * 输出参数：void
 * 返 回 值：void
 * 创建日期：2024年7月19日
 * 修改日期：
 * 注    意：
 *********************************************************************************************************/
void highpassFilter_IIR(float *data, float *px, float *py)
{
  Butterworth_2N((float *)b, (float *)a, ORDER, ORDER, data, 1, px, py, 0); // 2阶低通
}

